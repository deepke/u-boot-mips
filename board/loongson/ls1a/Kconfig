## board/loongson/ls1a/Kconfig
```kconfig
if TARGET_LS1A

config SYS_BOARD
	default "ls1a"

config SYS_VENDOR
	default "loongson"

config SYS_CONFIG_NAME
	default "ls1a"

config SYS_TEXT_BASE
	default 0xbfc00000 if 32BIT

config SYS_DCACHE_LINE_SIZE
	default 0

config SYS_DCACHE_SIZE
	default 0

config SYS_ICACHE_LINE_SIZE
	default 0

config SYS_ICACHE_SIZE
	default 0

config  CPU_LOONGSON1A
	bool
	default y

config VIDEO_16BPP
	bool
	default y



endif
```

## board/loongson/ls1a500/Kconfig
```kconfig
if TARGET_LS1A500

config SYS_BOARD
	default "ls1a500"

config SYS_VENDOR
	default "loongson"

config SYS_CONFIG_NAME
	default "ls1a500"

config SYS_TEXT_BASE
	default 0xbe000000 if 32BIT
	default 0xffffffffbe000000 if 64BIT

config SYS_DCACHE_LINE_SIZE
	default 64

config SYS_ICACHE_SIZE
	default 65536

config SYS_ICACHE_LINE_SIZE
	default 64


endif
```

## board/loongson/ls2k/Kconfig
```kconfig
if TARGET_LS2K

config SYS_BOARD
	default "ls2k"

config SYS_VENDOR
	default "loongson"

config SYS_CONFIG_NAME
	default "ls2k"

config SYS_TEXT_BASE
	default 0xbe000000 if 32BIT
	default 0xffffffffbe000000 if 64BIT

config SYS_DCACHE_LINE_SIZE
	default 64

config SYS_ICACHE_SIZE
	default 65536

config SYS_ICACHE_LINE_SIZE
	default 64


endif
```

## doc/uImage.FIT/ls1a500-multi.its
```
/*
 * U-Boot uImage source file with multiple kernels, ramdisks and FDT blobs
 */

/dts-v1/;

/ {
	description = "Various kernels, ramdisks and FDT blobs";
	#address-cells = <1>;

	images {
		kernel-1 {
			description = "vmlinuz";
			data = /incbin/("./vmlinuz.bin");
			type = "kernel";
			arch = "mips";
			os = "linux";
			compression = "none";
			load = <0xffffffff81680000>;
			entry = <0x81680000>;
			hash-1 {
				algo = "md5";
			};
			hash-2 {
				algo = "sha1";
			};
		};


		ramdisk-1 {
			description = "rootfs.cpio.lzma";
			data = /incbin/("/loongson/buildroot/output.ls2k/images/rootfs.cpio.lzma");
			type = "ramdisk";
			arch = "mips";
			os = "linux";
			compression = "none";
			load = <0x84000000>;
			entry = <0x84000000>;
			hash-1 {
				algo = "sha1";
			};
		};


		fdt-1 {
			description = "fdt";
			data = /incbin/("/loongson/ls1a500/pmon-loongson3/zloader/LS1A500.dtb");
			type = "flat_dt";
			arch = "mips";
			compression = "none";
			hash-1 {
				algo = "crc32";
			};
		};
	
		gdb-1 {
			description = "gsbstub";
			data = /incbin/("gdbstub.bin64");
			type = "fpga";
			arch = "mips";
			os = "linux";
			compression = "none";
			load = <0x80008000>;
			entry = <0x80008000>;
			hash-1 {
				algo = "sha1";
			};
		};


	};

	configurations {
		default = "config-1";

		config-1 {
			description = "tqm5200 vanilla-2.6.23 configuration";
			kernel = "kernel-1";
			ramdisk = "ramdisk-1";
			fdt = "fdt-1";
			gdb = "gdb-1";
			loadables = "kernel-1", "ramdisk-1", "gdb-1";
		};

	};
};

/*
make vmlinuz vmlinuz.bin
entry=$(LC_ALL=C readelf  -e vmlinuz|grep Entry|grep -o 0x.*)
sed -i "19s/load = <\S\+>/load = <$entry>/;20s/entry = <\S\+>/entry = <$entry>/" multi.its
mkimage -f multi.its uImage
*/
```
